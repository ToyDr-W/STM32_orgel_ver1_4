//ｱﾝﾊﾟﾝﾏﾝﾄﾞﾗｲﾌのﾍﾟﾀﾞﾙ部をﾏｲｺﾝ換装するためのｱﾌﾟﾘｹｰｼｮﾝ例


//==============================================
//構成情報(個別ｱﾌﾟﾘｹｰｼｮﾝだけで使うもの)
//==============================================
#define	SLEEP_TMR	1000			//Sleepに入る前の時限[ms]
						//　操作の評価時間よりも長くすること


//==============================================
//固有の作業域
//==============================================
static unsigned short smp=4000;			//ｴﾝｼﾞﾝ音のｻﾝﾌﾟﾙﾚｰﾄ[sps]


//==============================================
//ｱﾌﾟﾘの初期設定
//==============================================
static void apl_init(void)
{

DBG_C('\n');
DBG_C('$');

DBG_C('p');
	RCC->APB2ENR|=RCC_APB2ENR_SYSCFGEN;	//SYSCFGにｸﾛｯｸ供給
	GPIO_INPU(SW0_GPIO,SW0_BIT);		//入力ﾓｰﾄﾞﾌﾟﾙｱｯﾌﾟする


	VOICEN_SEL(0,1);
	VOICEN_SMP(0,smp);


DBG_C('>');
}


//==============================================
//EXTI割込みﾊﾝﾄﾞﾗ
//==============================================
void EXTI0_1_IRQHandler(void)
{

	EXTI->PR=0x00000003;			//EXTI0-1割込みﾌﾗｸﾞをｸﾘｱする
}

void EXTI2_3_IRQHandler(void)
{

	EXTI->PR=0x0000000c;			//EXTI2-3割込みﾌﾗｸﾞをｸﾘｱする
}

void EXTI4_15_IRQHandler(void)
{

	EXTI->PR=0x0000fff0;			//EXTI4-115割込みﾌﾗｸﾞをｸﾘｱする
}


//==============================================
//固有の処理(ｺｰﾙﾊﾞｯｸ関数)
//
//動作仕様
//・ｴﾝｼﾞﾝ音は音声N0
//
//音声
//1.ｱｲﾄﾞﾘﾝｸﾞ
//==============================================
static void CB_KOYUU(void)
{


	if(GPIO_R(SW0_GPIO,SW0_BIT))
	{
		if(smp>4000) smp-=200;
	}
	else
	{
		if(smp<15000) smp+=500;
	}
	VOICEN_SMP(0,smp);		//ｻﾝﾌﾟﾙﾚｰﾄを設定する

DBG_C('>');
}


//==============================================
//演奏終了時の処理(ｺｰﾙﾊﾞｯｸ関数)
//==============================================
static void CB_SONG_END(void)
{
}


//==============================================
//音声N再生終了時の処理(ｺｰﾙﾊﾞｯｸ関数)
//==============================================
static void CB_VOICEN_END(
	unsigned char ch)			//音声Nのch番号
{

	//ｴﾝｼﾞﾝの制御
	if(ch==0)
	{
		VOICEN_SEL(0,1);		//定常音を連続再生する
		VOICEN_SMP(0,smp);		//ｻﾝﾌﾟﾙﾚｰﾄを設定する
	}
}
