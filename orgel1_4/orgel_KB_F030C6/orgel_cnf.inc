SYS_CLK equ 64 
BTL equ 0 
PWM_STEP equ 1024 
PWM_FRQ equ (SYS_CLK*1000/PWM_STEP) 
PWM_PR equ (PWM_STEP/SYS_CLK) 
PWM_DB_CMP equ 10 
PWM_DB_BRG equ 10 
OUT_BUF_N equ 50 
SPI_BUF_N equ 8 
SONG_PS equ 2 
KOYUU_PR equ 32 
VOICEN0_VOL equ 100 
VOICEN1_VOL equ 100 
VOICEN2_VOL equ 100 
VOICEI_VOL equ 100 
VOICEC_VOL equ 100 
VOICES0_VOL equ 100 
VOICES1_VOL equ 100 
VOICES2_VOL equ 100 
ORGEL_VOL equ 60 
KB0_VOL equ 60 
KB1_VOL equ 60 
VOICE_N equ 0 
VOICE_I equ 0 
VOICE_C equ 0 
VOICE_S equ 0 
PART_N equ 2 
KB_N equ 2 
KB_PSN equ (100000000/30/PWM_PR/SONG_PS/8+5)/10 
KB_EPSENV equ (23000*10/PWM_PR/SONG_PS+5)/10 
KB_PPSPIT equ (1000*10/PWM_PR/SONG_PS+5)/10 
 end 
